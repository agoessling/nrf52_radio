## boards/arm/bt840xe_breakout/Kconfig.board
```kconfig
# Copyright (c) 2023 Nordic Semiconductor ASA
# SPDX-License-Identifier: Apache-2.0

config BOARD_BT840XE_BREAKOUT
	bool "bt840xe_breakout"
	depends on SOC_NRF52840_QIAA
```

## boards/arm/bt840xe_breakout/Kconfig.defconfig
```kconfig
# Copyright (c) 2023 Nordic Semiconductor ASA
# SPDX-License-Identifier: Apache-2.0

if BOARD_BT840XE_BREAKOUT

config BOARD
	default "bt840xe_breakout"

config BT_CTLR
   default BT

endif
```

## boards/arm/ev_bt840/Kconfig.defconfig
```kconfig
# Copyright (c) 2023 Nordic Semiconductor ASA
# SPDX-License-Identifier: Apache-2.0

if BOARD_EV_BT840

config BOARD
	default "ev_bt840"

config BT_CTLR
   default BT

endif
```

## boards/arm/test_board/Kconfig.defconfig
```kconfig
# Copyright (c) 2023 Nordic Semiconductor ASA
# SPDX-License-Identifier: Apache-2.0

if BOARD_TEST_BOARD

config BOARD
	default "test_board"

config BT_CTLR
   default BT

endif
```
